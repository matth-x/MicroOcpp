## examples/ESP-IDF/main/Kconfig.projbuild
```kconfig
menu "Example Configuration"

    config ESP_WIFI_SSID
        string "WiFi SSID"
        default "myssid"
        help
            SSID (network name) for the example to connect to.

    config ESP_WIFI_PASSWORD
        string "WiFi Password"
        default "mypassword"
        help
            WiFi password (WPA or WPA2) for the example to use.

    config ESP_MAXIMUM_RETRY
        int "Maximum retry"
        default 5
        help
            Set the Maximum retry to avoid station reconnecting to the AP unlimited when the AP is really inexistent.
    
    config MO_OCPP_BACKEND
        string "OCPP backend URL"
        default "ws://echo.websocket.events/"
        help
            URL of the OCPP backend
    
    config MO_CHARGEBOXID
        string "ChargeBoxId"
        default ""
        help
            ChargeBoxId as it appears in the WebSocket connection URL

    config MO_AUTHORIZATIONKEY
        string "Authorization Key"
        default ""
        help
            Passphrase for connecting to the OCPP server
endmenu
```
